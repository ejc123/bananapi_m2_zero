## uboot/uboot.defconfig
```kconfig
CONFIG_ARM=y
CONFIG_ARCH_SUNXI=y
CONFIG_ENV_SIZE=0x20000
CONFIG_ENV_OFFSET=0x100000
CONFIG_DEFAULT_DEVICE_TREE="sun8i-h2-plus-bananapi-m2-zero"
CONFIG_SPL=y
CONFIG_MACH_SUN8I_H3=y
CONFIG_DRAM_CLK=408
# CONFIG_HAS_ARMV7_SECURE_BASE is not set
# CONFIG_ARMV7_LPAE is not set
# CONFIG_SYS_MALLOC_CLEAR_ON_INIT is not set
CONFIG_BOOTDELAY=5
CONFIG_LOGLEVEL=6
CONFIG_BOARD_TYPES=y
# CONFIG_BOOTM_NETBSD is not set
# CONFIG_BOOTM_PLAN9 is not set
# CONFIG_BOOTM_RTEMS is not set
# CONFIG_BOOTM_VXWORKS is not set
CONFIG_CMD_SQUASHFS=y
# CONFIG_ISO_PARTITION is not set
# CONFIG_ENV_IS_IN_FAT is not set
CONFIG_ENV_IS_IN_MMC=y
# CONFIG_NET is not set
# CONFIG_I2C is not set
CONFIG_VIDEO_ANSI=y
CONFIG_REGEX=y
# CONFIG_EFI_LOADER is not set
```
